## drivers/Kconfig
```kconfig
config DRIVERS
    bool "Enable Driver"
    default y
    help
      Answer Y to enable LiteOS support driver.

source "../Kconfig"

# Device driver Kconfig import
osource "$(DEVICE_PATH)/drivers/Kconfig"
```
